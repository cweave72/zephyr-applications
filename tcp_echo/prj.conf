## prj.conf
```kconfig
CONFIG_GPIO=y
CONFIG_LOG=y
CONFIG_PRINTK=y
CONFIG_EVENTS=y

# Common-modules
CONFIG_WIFICONNECT=y
CONFIG_TCPSOCKET=y
CONFIG_TCPSERVER=y
CONFIG_TCPECHO=y
CONFIG_NVPARMS=y

# Standard thread options
CONFIG_THREAD_STACK_INFO=y
CONFIG_THREAD_NAME=y
CONFIG_THREAD_MONITOR=y
CONFIG_THREAD_RUNTIME_STATS=y
CONFIG_THREAD_RUNTIME_STATS_USE_TIMING_FUNCTIONS=y

# Required by NvParms
CONFIG_FLASH=y
CONFIG_FLASH_MAP=y
CONFIG_NVS=y
CONFIG_SETTINGS=y
CONFIG_SETTINGS_RUNTIME=y
CONFIG_SETTINGS_NVS=y

# Enable the shell
CONFIG_SHELL=y
CONFIG_SETTINGS_SHELL=y

# Required by WifiConnect module
CONFIG_NETWORKING=y
CONFIG_WIFI=y
CONFIG_NET_L2_WIFI_MGMT=y
CONFIG_NET_L2_ETHERNET=y
CONFIG_NET_IPV4=y
CONFIG_NET_DHCPV4=y

# Required by TcpSocket
CONFIG_NET_TCP=y
CONFIG_POSIX_API=y
CONFIG_POSIX_NETWORKING=y

# Debugging
CONFIG_NET_LOG=y
CONFIG_WIFI_LOG_LEVEL_ERR=y

# Common-module debug levels
CONFIG_WIFICONNECT_LOG_LEVEL_INF=y
CONFIG_NVPARMS_LOG_LEVEL_DBG=y
```

## boards/esp32s3_qtpy_procpu.overlay
```dts
/ {

};

&wifi {
	status = "okay";
};
```

## src/main.c
```c
/** @brief This examples demonstrates:
    Using the devicetree for accessing a gpio led.
    Creating threads.
    Using event flags.
*/
#include <zephyr/kernel.h>
#include <zephyr/device.h>
#include <zephyr/devicetree.h>
#include <zephyr/logging/log.h>
#include <zephyr/drivers/gpio.h>
#include "WifiConnect.h"
#include "TcpEcho.h"
#include "NvParms.h"

/** @brief Initialize the logging module. */
LOG_MODULE_REGISTER(app, LOG_LEVEL_DBG);


static TcpEcho tcp_echo;

static int
init_wifi(void)
{
    char ssid[32];
    char pass[32];
    int ret, pass_len;

    ret = NvParms_load("ssid", NVPARMS_TYPE_STRING, ssid, sizeof(ssid));
    if (ret <= 0)
    {
        LOG_ERR("Error getting ssid from NV: %d", ret);
        return -1;
    }

    pass_len = NvParms_load("pass", NVPARMS_TYPE_STRING, pass, sizeof(pass));
    if (pass_len <= 0)
    {
        LOG_ERR("Error getting pass from NV: %d", pass_len);
        return -1;
    }

    LOG_DBG("ssid=%s", ssid);
    LOG_DBG("password length=%d", pass_len);

    WifiConnect_init();
    WifiConnect_connect(ssid, pass);
    return 0;
}

int main(void)
{
    int ret;

    LOG_INF("TCP Echo app.");

    ret = NvParms_init();
    if (ret < 0)
    {
        LOG_ERR("NvParms module init error : %d", ret);
        return 0;
    }

    init_wifi();

    ret = TcpEcho_init(
        &tcp_echo,
        12001,
        NULL,
        1024,
        4*1024,
        "TCP Echo",
        20);
    if (ret < 0) LOG_ERR("Error initializing Tcp Echo server: %d",  ret);

    while (1)
    {
        k_msleep(1000);
    }

    return 0;
}
```
