## fs_demo/Kconfig
```kconfig
mainmenu "FsApi littlefs demo with remote file access over RPC."

menu "App Options"

	choice APP_NET_TYPE
		prompt "Network type"
		default APP_NET_TYPE_ETH

		config APP_NET_TYPE_WIFI
		bool "wifi network"

		config APP_NET_TYPE_SERIAL
		bool "serial net"

		config APP_NET_TYPE_ETH
		bool "wired ethernet networking"

		config APP_NET_TYPE_USB
		bool "usb (CDC-ECM) networking"
	endchoice

	config APP_USE_STATIC_IP
	    bool "Use a static IP address rather than DHCP."

	config APP_IPV4_ADDR
	    string "Static IPv4 address."
	    default "192.168.1.15"

	config APP_IPV4_MASK
	    string "Static IPv4 netmask."
	    default "255.255.255.0"

	config APP_IPV4_GW
	    string "Static IPv4 gateway."
	    default "192.168.1.1"

endmenu

source "Kconfig.zephyr"

module = APP
module-str = "app"
source "subsys/logging/Kconfig.template.log_config"
```
