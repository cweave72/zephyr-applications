## CMakeLists.txt
```
cmake_minimum_required(VERSION 3.13.1)
message("WORKSPACE_BASE = $ENV{WORKSPACE_BASE}")
message("ZEPHYR_BASE = $ENV{ZEPHYR_BASE}")
message("ZEPHYR_SDK_INSTALL_DIR = $ENV{ZEPHYR_SDK_INSTALL_DIR}")
message("ZEPHYR_TOOLCHAIN_VARIANT = $ENV{ZEPHYR_TOOLCHAIN_VARIANT}")

set(CONFIG_OUTPUT_DISASSEMBLY y CACHE INTERNAL "")
set(CONFIG_OUTPUT_DISASSEMBLY_WITH_SOURCE y CACHE INTERNAL "")

list(APPEND EXTRA_CONF_FILE
    ${CMAKE_CURRENT_SOURCE_DIR}/conf/kernel.conf
    ${CMAKE_CURRENT_SOURCE_DIR}/conf/modules.conf
    ${CMAKE_CURRENT_SOURCE_DIR}/conf/led.conf
    ${CMAKE_CURRENT_SOURCE_DIR}/conf/net.conf
    ${CMAKE_CURRENT_SOURCE_DIR}/conf/rpc.conf
)

# Which networking fragment to apply. Declare the type with
# CONFIG_APP_NET_TYPE_<X>=y in boards/<board>.conf (or prj.conf); the helper reads
# that declaration here, because CONFIG_* are not CMake variables until
# find_package(Zephyr) below has run Kconfig -- by which point EXTRA_CONF_FILE is
# already consumed. See the header of app_net_type.cmake.
#
# The "eth" fallback must match the 'choice APP_NET_TYPE' default in Kconfig.
include($ENV{WORKSPACE_BASE}/common/scripts/cmake/app_net_type.cmake)
app_net_type_resolve(APP_NET_TYPE eth)

if (APP_NET_TYPE STREQUAL "wifi")
    list(APPEND EXTRA_CONF_FILE ${CMAKE_CURRENT_SOURCE_DIR}/conf/wifi.conf)
elseif (APP_NET_TYPE STREQUAL "serial")
    list(APPEND EXTRA_CONF_FILE ${CMAKE_CURRENT_SOURCE_DIR}/conf/serial_net.conf)
elseif (APP_NET_TYPE STREQUAL "eth")
    list(APPEND EXTRA_CONF_FILE ${CMAKE_CURRENT_SOURCE_DIR}/conf/wired_eth_net.conf)
elseif (APP_NET_TYPE STREQUAL "usb")
    list(APPEND EXTRA_CONF_FILE ${CMAKE_CURRENT_SOURCE_DIR}/conf/usb_net.conf)
endif()

# Which serial port the bridge remotes. A devicetree overlay cannot be selected
# by Kconfig, so this is a CMake cache variable that picks both the conf
# fragment and the overlay. Kconfig 'choice APP_SERIAL_SRC' mirrors it and is
# verified after find_package(Zephyr) below. Switching needs PRISTINE=y.
#
#   make BOARD=w55rp20_evb_pico PRISTINE=y build                                  # uart0
#   make BOARD=w55rp20_evb_pico PRISTINE=y CMAKE_OPTS="-DAPP_SERIAL_SRC=cdc_acm" build
set(APP_SERIAL_SRC "uart0" CACHE STRING "Serial port bridged to TCP: uart0 | cdc_acm")
if (APP_SERIAL_SRC STREQUAL "uart0")
    list(APPEND EXTRA_CONF_FILE        ${CMAKE_CURRENT_SOURCE_DIR}/conf/serial_uart0.conf)
    list(APPEND EXTRA_DTC_OVERLAY_FILE ${CMAKE_CURRENT_SOURCE_DIR}/boards/serial_uart0.overlay)
elseif (APP_SERIAL_SRC STREQUAL "cdc_acm")
    list(APPEND EXTRA_CONF_FILE        ${CMAKE_CURRENT_SOURCE_DIR}/conf/serial_cdc_acm.conf)
    list(APPEND EXTRA_DTC_OVERLAY_FILE ${CMAKE_CURRENT_SOURCE_DIR}/boards/serial_cdc_acm.overlay)
else()
    message(FATAL_ERROR "[app] APP_SERIAL_SRC='${APP_SERIAL_SRC}'; expected uart0 or cdc_acm.")
endif()
message(STATUS "[app] Bridged serial source: ${APP_SERIAL_SRC}")

# Applied LAST so the addressing decision cannot be overridden by a transport
# fragment. CONFIG_NET_DHCPV4 and the APP_IPV4_* symbols live only in this file.
list(APPEND EXTRA_CONF_FILE ${CMAKE_CURRENT_SOURCE_DIR}/conf/ip.conf)

find_package(Zephyr REQUIRED HINTS $ENV{ZEPHYR_BASE})

# Kconfig has now run. Fail loudly if it disagrees with the fragment we applied.
app_net_type_verify(${APP_NET_TYPE})

if ((APP_SERIAL_SRC STREQUAL "uart0"   AND NOT CONFIG_APP_SERIAL_SRC_UART0) OR
    (APP_SERIAL_SRC STREQUAL "cdc_acm" AND NOT CONFIG_APP_SERIAL_SRC_CDC_ACM))
    message(FATAL_ERROR "[app] APP_SERIAL_SRC='${APP_SERIAL_SRC}' disagrees with Kconfig.")
endif()
if (NOT CONFIG_SERIALPIPE)
    message(FATAL_ERROR "[app] CONFIG_SERIALPIPE is not set. Check its Kconfig dependencies.")
endif()

project(net_serial_bridge)

set(target app)

# Include the cmake script which builds protobuf bindings.
include($ENV{WORKSPACE_BASE}/common/scripts/cmake/build_proto.cmake)

# The following creates the target ${target}_proto.
nanopb_build_sources(${target}
    $ENV{WORKSPACE_BASE}/proto
    $ENV{WORKSPACE_BASE}/applications/net_serial_bridge/proto
)

target_sources(
    ${target}
    PRIVATE
    src/main.c
    src/led.c
    src/rpc.c
    )

# The bridge needs both SerialPipe and TcpServer; app.h stubs app_bridge_init()
# otherwise.
target_sources_ifdef(
    CONFIG_SERIALPIPE
    ${target}
    PRIVATE
    src/bridge_serial.c
    src/bridge_tcp.c
    )

# Exactly one net_*.c provides app_net_init(). net_l4.c carries the bring-up
# sequence shared by the three transports that use Zephyr's connection manager.
target_sources_ifdef(
    CONFIG_APP_NET_TYPE_WIFI
    ${target}
    PRIVATE
    src/net_wifi.c
    )

target_sources_ifdef(
    CONFIG_APP_NET_TYPE_SERIAL
    ${target}
    PRIVATE
    src/net_wired.c
    src/net_l4.c
    )

target_sources_ifdef(
    CONFIG_APP_NET_TYPE_ETH
    ${target}
    PRIVATE
    src/net_wired.c
    src/net_l4.c
    )

target_sources_ifdef(
    CONFIG_APP_NET_TYPE_USB
    ${target}
    PRIVATE
    src/net_usb.c
    src/net_l4.c
    )

target_sources_ifdef(
    CONFIG_APP_USE_STATIC_IP
    ${target}
    PRIVATE
    src/net_ip.c
    )

target_compile_options(
    ${target}
    PUBLIC
    -fmax-errors=5
    )

target_link_libraries(
    ${target}
    INTERFACE
    ${target}_proto
    )
```

## Kconfig
```
mainmenu "Remote a UART stream over TCP."

menu "App Options"

	choice APP_NET_TYPE
		prompt "Network type"
		default APP_NET_TYPE_ETH

		config APP_NET_TYPE_WIFI
		bool "wifi network"

		config APP_NET_TYPE_SERIAL
		bool "serial net"

		config APP_NET_TYPE_ETH
		bool "wired ethernet networking"

		config APP_NET_TYPE_USB
		bool "usb (CDC-ECM) networking"
	endchoice

	config APP_USE_STATIC_IP
	    bool "Use a static IP address rather than DHCP."

	config APP_IPV4_ADDR
	    string "Static IPv4 address."
	    default "192.168.1.15"

	config APP_IPV4_MASK
	    string "Static IPv4 netmask."
	    default "255.255.255.0"

	config APP_IPV4_GW
	    string "Static IPv4 gateway."
	    default "192.168.1.1"

	# Mirrors the APP_SERIAL_SRC CMake variable, which also selects the
	# devicetree overlay. CMakeLists.txt verifies the two agree.
	choice APP_SERIAL_SRC
		prompt "Serial port bridged to TCP"
		default APP_SERIAL_SRC_UART0

		config APP_SERIAL_SRC_UART0
		bool "uart0 (GP0/GP1); console stays on USB CDC-ACM"

		config APP_SERIAL_SRC_CDC_ACM
		bool "USB CDC-ACM; console moves to uart0"
	endchoice

	menu "Serial bridge"

		config APP_BRIDGE_TCP_PORT
		    int "TCP port the bridge listens on."
		    default 12001

		config APP_BRIDGE_ITEM_SIZE
		    int "Bytes per serial->TCP queue item."
		    default 256
		    range 16 4096

		config APP_BRIDGE_POOL_DEPTH
		    int "Number of serial->TCP queue items."
		    default 16

		config APP_BRIDGE_SERIAL_POLL_MS
		    int "Serial receive poll period, ms. One empty poll flushes a partial item."
		    default 2

		config APP_BRIDGE_TCP_POLL_MS
		    int "TcpServer receive poll timeout, ms. Sets the serial->TCP latency floor."
		    default 10

		config APP_BRIDGE_TX_WAIT_MS
		    int "Max time to wait for SerialPipe transmit pool space, ms."
		    default 250

		config APP_BRIDGE_SERIAL_STACK_SIZE
		    int "Stack size for the serial receive thread."
		    default 1024

		config APP_BRIDGE_SERIAL_THREAD_PRIO
		    int "Priority for the serial receive thread."
		    default 9

		config APP_BRIDGE_TCP_STACK_SIZE
		    int "Stack size for the bridge TcpServer thread."
		    default 4096

		config APP_BRIDGE_TCP_THREAD_PRIO
		    int "Priority for the bridge TcpServer thread."
		    default 10

	endmenu

endmenu

source "Kconfig.zephyr"

module = APP
module-str = "app"
source "subsys/logging/Kconfig.template.log_config"
```

## prj.conf
```kconfig
CONFIG_MAIN_STACK_SIZE=2048

CONFIG_APP_LOG_LEVEL_INF=y
CONFIG_LOG_BUFFER_SIZE=1024
```

## boards/w55rp20_evb_pico.conf
```kconfig
# Network transport for this board. This single declaration drives both
# the Kconfig symbol and which conf/ fragment the build applies (see
# CMakeLists.txt and common/scripts/cmake/app_net_type.cmake).
CONFIG_APP_NET_TYPE_ETH=y
```

## boards/serial_cdc_acm.overlay
```dts
/*
 * Bridge the USB CDC-ACM port to TCP. The console and shell move to uart0
 * (GP0/GP1) so they do not share the bridged port. Applied through
 * EXTRA_DTC_OVERLAY_FILE when APP_SERIAL_SRC=cdc_acm.
 */

/ {
	chosen {
		zephyr,uart-pipe = &cdc_acm_uart0;
		zephyr,console = &uart0;
		zephyr,shell-uart = &uart0;
	};
};
```

## boards/serial_uart0.overlay
```dts
/*
 * Bridge uart0 (GP0/GP1) to TCP. The console stays on USB CDC-ACM, the board
 * default. Applied through EXTRA_DTC_OVERLAY_FILE when APP_SERIAL_SRC=uart0.
 *
 * Wiring (Raspberry Pi Debug Probe "U" connector): probe TX -> GP1 (UART0 RX),
 * probe RX -> GP0 (UART0 TX), GND -> GND.
 */

/ {
	chosen {
		zephyr,uart-pipe = &uart0;
	};
};
```

## src/main.c
```c
/** @brief Remote a UART stream over TCP.
 *
 *  Generated by app_gen. Subsystem setup lives in src/app.h; see the README.
 */
#include <zephyr/kernel.h>
#include <zephyr/logging/log.h>

#include "app.h"

/** @brief Initialize the logging module. */
LOG_MODULE_REGISTER(app, CONFIG_APP_LOG_LEVEL);

int
main(void)
{
    int ret;

    LOG_INF("net_serial_bridge starting.");

    /* Not fatal: a board without an led0 alias logs a warning and continues. */
    (void)app_led_init();

    ret = app_net_init();
    if (ret < 0)
    {
        LOG_ERR("Network init failed: %d", ret);
        return 0;
    }

    ret = app_rpc_init();
    if (ret < 0)
    {
        LOG_ERR("RPC init failed: %d", ret);
        return 0;
    }

    ret = app_bridge_init();
    if (ret < 0)
    {
        LOG_ERR("Bridge init failed: %d", ret);
        return 0;
    }

    app_trace_init();

    LOG_INF("net_serial_bridge running.");

    while (1)
    {
        k_msleep(5000);
    }

    return 0;
}
```

## src/app.h
```c
/*******************************************************************************
 *  @file: app.h
 *
 *  @brief: Application-level init contract.
 *
 *  Each optional subsystem provides one app_*_init(). When a subsystem is not
 *  built, a no-op inline stands in, so main.c carries no preprocessor logic and
 *  reads identically in every generated app.
 *
 *  Networking is resolved at BUILD time, not generation time: the transport is
 *  declared per board in boards/<board>.conf and resolved by
 *  app_net_type_resolve(), so one app can be wifi on one board and eth on
 *  another. That is why app_net_init() stays behind CONFIG_APP_NET_TYPE_*
 *  rather than being generated in or out.
*******************************************************************************/
#ifndef APP_H
#define APP_H

/* Brings in app_led_init(), app_led_set() and app_led_toggle(). Included here
   rather than re-declaring app_led_init, so led.h stays the single declaration
   site for the LED API. */
#include "led.h"

/** @brief Brings the network up and blocks until it is usable.
    Provided by exactly one of src/net_*.c -- see CMakeLists.txt. */
#if defined(CONFIG_APP_NET_TYPE_WIFI) || defined(CONFIG_APP_NET_TYPE_SERIAL) \
    || defined(CONFIG_APP_NET_TYPE_ETH) || defined(CONFIG_APP_NET_TYPE_USB)
int app_net_init(void);
#else
static inline int app_net_init(void) { return 0; }
#endif

#if defined(CONFIG_TCPRPCSERVER)
int app_rpc_init(void);
#else
static inline int app_rpc_init(void) { return 0; }
#endif

#if defined(CONFIG_TRACERAM)
int app_trace_init(void);
#else
static inline int app_trace_init(void) { return 0; }
#endif

/** @brief Starts the serial <-> TCP bridge. Provided by src/bridge_tcp.c. */
#if defined(CONFIG_SERIALPIPE) && defined(CONFIG_TCPSERVER)
int app_bridge_init(void);
#else
static inline int app_bridge_init(void) { return 0; }
#endif

#endif /* APP_H */
```

## src/bridge.h
```c
/*******************************************************************************
 *  @file: bridge.h
 *
 *  @brief: Serial-to-TCP bridge internals shared by bridge_serial.c and
 *  bridge_tcp.c.
*******************************************************************************/
#ifndef BRIDGE_H
#define BRIDGE_H

#include <stdint.h>
#include <zephyr/kernel.h>

/** @brief One chunk of received serial bytes queued for the TCP thread. */
struct bridge_item
{
    /** @brief Reserved for use by the kernel fifo. Must be the first member. */
    void *fifo_rsvd;
    /** @brief Number of valid bytes in data. */
    uint16_t len;
    /** @brief Received serial bytes. */
    uint8_t data[CONFIG_APP_BRIDGE_ITEM_SIZE];
};

/******************************************************************************
    bridge_serial_init
*//**
    @brief Initializes SerialPipe and starts the serial receive thread.
    @return Returns 0 on success, negative on error.
******************************************************************************/
int
bridge_serial_init(void);

/******************************************************************************
    bridge_serial_get
*//**
    @brief Takes the oldest queued item without blocking.

    Return the item with bridge_serial_free() after use.

    @return Returns the item, or NULL when the queue is empty.
******************************************************************************/
struct bridge_item *
bridge_serial_get(void);

/******************************************************************************
    bridge_serial_free
*//**
    @brief Returns an item to the pool.
    @param[in] item  Item obtained from bridge_serial_get().
******************************************************************************/
void
bridge_serial_free(struct bridge_item *item);

#endif /* BRIDGE_H */
```

## src/bridge_serial.c
```c
/*******************************************************************************
 *  @file: bridge_serial.c
 *
 *  @brief: Serial side of the bridge. A thread polls SerialPipe for received
 *  bytes, packs them into items and queues the items for the TCP thread.
*******************************************************************************/
#include <zephyr/kernel.h>
#include <zephyr/logging/log.h>

#include "CheckCond.h"
#include "SerialPipe.h"
#include "bridge.h"

LOG_MODULE_DECLARE(app, CONFIG_APP_LOG_LEVEL);

/** @brief Gate holding the receive thread until initialization completes. */
static K_SEM_DEFINE(init_sem, 0, 1);

/** @brief Pool of items. Only the receive thread allocates from it. */
K_MEM_SLAB_DEFINE_STATIC(item_pool, sizeof(struct bridge_item),
    CONFIG_APP_BRIDGE_POOL_DEPTH, 4);

/** @brief Items queued for the TCP thread, oldest first. */
static K_FIFO_DEFINE(s2t_fifo);

/** @brief Number of items dropped because the pool was full. */
static uint32_t drop_count;

/******************************************************************************
    item_alloc
*//**
    @brief Allocates an item. Drops the oldest queued item when the pool is
    full so a connecting client sees the most recent serial bytes.

    No app-level lock is needed. k_fifo and k_mem_slab are spinlock
    protected, this thread is the only allocator, and the TCP thread holds at
    most one item at a time.

    @return Returns the item, or NULL when every item is held by the TCP
    thread.
******************************************************************************/
static struct bridge_item *
item_alloc(void)
{
    struct bridge_item *item;
    struct bridge_item *old;

    if (k_mem_slab_alloc(&item_pool, (void **)&item, K_NO_WAIT) == 0)
    {
        return item;
    }

    old = k_fifo_get(&s2t_fifo, K_NO_WAIT);
    if (old)
    {
        k_mem_slab_free(&item_pool, (void *)old);

        drop_count++;
        if ((drop_count & 63) == 1)
        {
            LOG_WRN("Serial->TCP queue full, dropped %u items so far.",
                drop_count);
        }
    }

    if (k_mem_slab_alloc(&item_pool, (void **)&item, K_NO_WAIT) != 0)
    {
        return NULL;
    }
    return item;
}

/******************************************************************************
    rx_thread
*//**
    @brief Polls SerialPipe and queues received bytes.

    An item is queued when it is full, or when a whole poll period passes with
    no new bytes. A single empty read does not flush: over USB CDC-ACM bytes
    arrive in 64-byte packets, and flushing between packets would cut the
    pool capacity to one packet per item. Waiting bytes stay in SerialPipe's
    own fifo while the pool has no free item.
******************************************************************************/
static void
rx_thread(void *p1, void *p2, void *p3)
{
    struct bridge_item *cur = NULL;
    bool idle = false;

    (void)p1;
    (void)p2;
    (void)p3;

    /* Hold off until initialized, then re-post for any later waiter. */
    k_sem_take(&init_sem, K_FOREVER);
    k_sem_give(&init_sem);

    while (1)
    {
        int num;

        if (!cur)
        {
            cur = item_alloc();
            if (!cur)
            {
                k_msleep(CONFIG_APP_BRIDGE_SERIAL_POLL_MS);
                continue;
            }
            cur->len = 0;
        }

        num = SerialPipe_rxGet(cur->data + cur->len,
            sizeof(cur->data) - cur->len);
        if (num > 0)
        {
            cur->len += (uint16_t)num;
            idle = false;
            if (cur->len == sizeof(cur->data))
            {
                k_fifo_put(&s2t_fifo, cur);
                cur = NULL;
            }
            /* Keep draining while bytes flow. */
            continue;
        }

        if ((cur->len > 0) && idle)
        {
            /* Two empty reads one poll period apart: the sender paused. */
            k_fifo_put(&s2t_fifo, cur);
            cur = NULL;
        }

        idle = true;
        k_msleep(CONFIG_APP_BRIDGE_SERIAL_POLL_MS);
    }
}

K_THREAD_DEFINE(
    bridge_rx,
    CONFIG_APP_BRIDGE_SERIAL_STACK_SIZE,
    rx_thread,
    NULL,
    NULL,
    NULL,
    CONFIG_APP_BRIDGE_SERIAL_THREAD_PRIO,
    0,
    0);

/******************************************************************************
    bridge_serial_get
*//**
    @brief Takes the oldest queued item without blocking.
    @return Returns the item, or NULL when the queue is empty.
******************************************************************************/
struct bridge_item *
bridge_serial_get(void)
{
    return k_fifo_get(&s2t_fifo, K_NO_WAIT);
}

/******************************************************************************
    bridge_serial_free
*//**
    @brief Returns an item to the pool.
    @param[in] item  Item obtained from bridge_serial_get().
******************************************************************************/
void
bridge_serial_free(struct bridge_item *item)
{
    k_mem_slab_free(&item_pool, (void *)item);
}

/******************************************************************************
    bridge_serial_init
*//**
    @brief Initializes SerialPipe and starts the serial receive thread.
    @return Returns 0 on success, negative on error.
******************************************************************************/
int
bridge_serial_init(void)
{
    int ret;

    ret = SerialPipe_init();
    CHECK_COND_RETURN_MSG(ret < 0, ret, "SerialPipe init failed.");

    LOG_INF("Serial bridge: %u items x %u bytes, poll %u ms.",
        (uint32_t)CONFIG_APP_BRIDGE_POOL_DEPTH,
        (uint32_t)CONFIG_APP_BRIDGE_ITEM_SIZE,
        (uint32_t)CONFIG_APP_BRIDGE_SERIAL_POLL_MS);

    /* Release the receive thread. */
    k_sem_give(&init_sem);

    return 0;
}
```

## src/bridge_tcp.c
```c
/*******************************************************************************
 *  @file: bridge_tcp.c
 *
 *  @brief: TCP side of the bridge. The TcpServer thread forwards socket bytes
 *  to SerialPipe and drains the serial receive queue to the socket.
*******************************************************************************/
#include <errno.h>
#include <zephyr/kernel.h>
#include <zephyr/logging/log.h>
#include <zephyr/sys/util.h>

#include "CheckCond.h"
#include "SerialPipe.h"
#include "TcpServer.h"
#include "TcpSocket.h"
#include "app.h"
#include "bridge.h"

LOG_MODULE_DECLARE(app, CONFIG_APP_LOG_LEVEL);

/** @brief Size of the socket receive buffer handed to TcpServer. */
#define TCP_RX_BUF_SIZE     1024

/** @brief Sleep between SerialPipe_send() retries, ms. */
#define SEND_RETRY_MS       2

static TcpServer tcp_server;
static uint8_t tcp_rx_buf[TCP_RX_BUF_SIZE];

/******************************************************************************
    serial_send_wait
*//**
    @brief Queues bytes on SerialPipe, waiting a bounded time for pool space.

    Waiting here holds the TcpServer thread, which closes the TCP window
    while the UART drains. That is the intended backpressure.

    @param[in] data  Bytes to send.
    @param[in] len  Number of bytes. Must not exceed SerialPipe_sendSize().
    @return Returns 0 on success, negative on error or timeout.
******************************************************************************/
static int
serial_send_wait(const uint8_t *data, uint16_t len)
{
    uint32_t start = k_uptime_get_32();
    int ret;

    while ((ret = SerialPipe_send(data, len)) == -ENOMEM)
    {
        if ((k_uptime_get_32() - start) >= CONFIG_APP_BRIDGE_TX_WAIT_MS)
        {
            break;
        }
        k_msleep(SEND_RETRY_MS);
    }
    return ret;
}

/******************************************************************************
    bridge_callback
*//**
    @brief TcpServer callback. Runs on socket data and on every poll timeout.

    @param[in] server  TcpServer object (unused).
    @param[in] sock  Connected socket.
    @param[in] data  Received socket bytes.
    @param[in] len  Number of received bytes, 0 on poll timeout or peer close.
    @param[out] finished  Set to 1: close as soon as the peer has closed.
******************************************************************************/
static void
bridge_callback(void *server, int sock, uint8_t *data, uint16_t len,
    int *finished)
{
    size_t chunk_max = SerialPipe_sendSize();
    uint16_t off = 0;
    struct bridge_item *item;

    ARG_UNUSED(server);
    *finished = 1;

    /* TCP -> serial. */
    while (off < len)
    {
        uint16_t num = (uint16_t)MIN((size_t)(len - off), chunk_max);

        if (serial_send_wait(data + off, num) < 0)
        {
            LOG_WRN("Serial TX backlog, dropped %u bytes.",
                (unsigned int)(len - off));
            break;
        }
        off += num;
    }

    /* Serial -> TCP. */
    while ((item = bridge_serial_get()) != NULL)
    {
        int num = TcpSocket_write(sock, item->data, item->len);

        bridge_serial_free(item);
        if (num < 0)
        {
            /* Peer is gone. The next poll or read closes the socket. */
            break;
        }
    }
}

/******************************************************************************
    app_bridge_init
*//**
    @brief Starts the serial side, then the TCP server on the bridge port.
    @return Returns 0 on success, negative on error.
******************************************************************************/
int
app_bridge_init(void)
{
    int ret;

    ret = bridge_serial_init();
    CHECK_COND_RETURN_MSG(ret < 0, ret, "Bridge serial init failed.");

    ret = TcpServer_init(
        &tcp_server,
        CONFIG_APP_BRIDGE_TCP_PORT,
        tcp_rx_buf,
        sizeof(tcp_rx_buf),
        CONFIG_APP_BRIDGE_TCP_STACK_SIZE,
        "TCP Bridge",
        CONFIG_APP_BRIDGE_TCP_THREAD_PRIO,
        bridge_callback);
    CHECK_COND_RETURN_MSG(ret < 0, ret, "Bridge TcpServer init failed.");

    ret = TcpServer_setPollTimeout(&tcp_server, CONFIG_APP_BRIDGE_TCP_POLL_MS);
    CHECK_COND_RETURN_MSG(ret < 0, ret, "Bridge poll timeout rejected.");

    LOG_INF("Serial bridge listening on TCP port %u.",
        (unsigned int)CONFIG_APP_BRIDGE_TCP_PORT);

    return 0;
}
```
