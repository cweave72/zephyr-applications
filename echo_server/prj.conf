## CMakeLists.txt
```
cmake_minimum_required(VERSION 3.13.1)
message("ZEPHYR_BASE = $ENV{ZEPHYR_BASE}")

list(APPEND EXTRA_CONF_FILE
    ${CMAKE_CURRENT_SOURCE_DIR}/nv.conf
    ${CMAKE_CURRENT_SOURCE_DIR}/net.conf
    ${CMAKE_CURRENT_SOURCE_DIR}/modules.conf
)

find_package(Zephyr REQUIRED HINTS $ENV{ZEPHYR_BASE})
project(echo_server)

target_sources(app PRIVATE src/main.c)

target_compile_options(
    app
    PUBLIC
    -fmax-errors=5
)
```

## prj.conf
```kconfig
CONFIG_GPIO=y
CONFIG_LOG=y
CONFIG_PRINTK=y
CONFIG_EVENTS=y

# Standard thread options
CONFIG_THREAD_STACK_INFO=y
CONFIG_THREAD_NAME=y
CONFIG_THREAD_MONITOR=y
CONFIG_THREAD_RUNTIME_STATS=y
CONFIG_THREAD_RUNTIME_STATS_USE_TIMING_FUNCTIONS=y

CONFIG_WIFI=y
CONFIG_NET_L2_WIFI_MGMT=y

CONFIG_ECHOSERVER_TRANSPORT_UDP=y

# Debugging
CONFIG_WIFI_LOG_LEVEL_ERR=y
```

## modules.conf
```kconfig
# Enable local modules
CONFIG_WIFICONNECT=y
CONFIG_TCPSOCKET=y
CONFIG_TCPSERVER=y
CONFIG_UDPSOCKET=y
CONFIG_UDPSERVER=y
CONFIG_ECHOSERVER=y
CONFIG_NVPARMS=y

#Logging
CONFIG_WIFICONNECT_LOG_LEVEL_INF=y
CONFIG_TCPSOCKET_LOG_LEVEL_INF=y
CONFIG_TCPSERVER_LOG_LEVEL_INF=y
CONFIG_UDPSOCKET_LOG_LEVEL_DBG=y
CONFIG_UDPSERVER_LOG_LEVEL_DBG=y
CONFIG_ECHOSERVER_LOG_LEVEL_DBG=y
CONFIG_NVPARMS_LOG_LEVEL_DBG=y
```

## net.conf
```kconfig
# Network related configs.
CONFIG_NETWORKING=y
CONFIG_NET_L2_ETHERNET=y
CONFIG_NET_IPV4=y
CONFIG_NET_DHCPV4=y
CONFIG_NET_TCP=y
CONFIG_NET_UDP=y

CONFIG_POSIX_API=y
CONFIG_POSIX_NETWORKING=y

# Shell
CONFIG_NET_SHELL=y

# Debugging
CONFIG_NET_LOG=y
```

## boards/esp32_devkitc_wroom_procpu.conf
```kconfig
CONFIG_WIFI_ESP32=y
CONFIG_ESP32_WIFI_STA_AUTO_DHCPV4=y
CONFIG_ESP32_WIFI_STA_RECONNECT=y
```

## src/main.c
```c
/** @brief This examples demonstrates:
    Using the devicetree for accessing a gpio led.
    Creating threads.
    Using event flags.
*/
#include <zephyr/kernel.h>
#include <zephyr/device.h>
#include <zephyr/devicetree.h>
#include <zephyr/logging/log.h>
#include <zephyr/drivers/gpio.h>
#include "WifiConnect.h"
#include "EchoServer.h"
#include "NvParms.h"

/** @brief Initialize the logging module. */
LOG_MODULE_REGISTER(app, LOG_LEVEL_DBG);


static EchoServer echo;

static int
init_wifi(void)
{
    char ssid[32];
    char pass[32];
    int ret, pass_len;

    ret = NvParms_load("ssid", NVPARMS_TYPE_STRING, ssid, sizeof(ssid));
    if (ret <= 0)
    {
        LOG_ERR("Error getting ssid from NV: %d", ret);
        return -1;
    }

    pass_len = NvParms_load("pass", NVPARMS_TYPE_STRING, pass, sizeof(pass));
    if (pass_len <= 0)
    {
        LOG_ERR("Error getting pass from NV: %d", pass_len);
        return -1;
    }

    LOG_DBG("ssid=%s", ssid);
    LOG_DBG("password length=%d", pass_len);

    WifiConnect_init();
    WifiConnect_connect(ssid, pass);
    return 0;
}

int main(void)
{
    int ret;

    LOG_INF("TCP Echo app.");

    ret = NvParms_init();
    if (ret < 0)
    {
        LOG_ERR("NvParms module init error : %d", ret);
        return 0;
    }

    init_wifi();

    ret = EchoServer_init(
        &echo,
        12001,
        NULL,
        1024,
        4*1024,
        "Echo Server",
        20);
    if (ret < 0) LOG_ERR("Error initializing Echo server: %d",  ret);

    while (1)
    {
        k_msleep(1000);
    }

    return 0;
}
```
