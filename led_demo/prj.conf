## CMakeLists.txt
```
cmake_minimum_required(VERSION 3.13.1)
message("WORKSPACE_BASE = $ENV{WORKSPACE_BASE}")
message("ZEPHYR_BASE = $ENV{ZEPHYR_BASE}")
message("ZEPHYR_SDK_INSTALL_DIR = $ENV{ZEPHYR_SDK_INSTALL_DIR}")
message("ZEPHYR_TOOLCHAIN_VARIANT = $ENV{ZEPHYR_TOOLCHAIN_VARIANT}")

set(CONFIG_OUTPUT_DISASSEMBLY y CACHE INTERNAL "")
set(CONFIG_OUTPUT_DISASSEMBLY_WITH_SOURCE y CACHE INTERNAL "")

list(APPEND EXTRA_CONF_FILE
    ${CMAKE_CURRENT_SOURCE_DIR}/conf/kernel.conf
    ${CMAKE_CURRENT_SOURCE_DIR}/conf/modules.conf
    ${CMAKE_CURRENT_SOURCE_DIR}/conf/led.conf
    ${CMAKE_CURRENT_SOURCE_DIR}/conf/net.conf
    ${CMAKE_CURRENT_SOURCE_DIR}/conf/rpc.conf
)

# Which networking fragment to apply. Declare the type with
# CONFIG_APP_NET_TYPE_<X>=y in boards/<board>.conf (or prj.conf); the helper reads
# that declaration here, because CONFIG_* are not CMake variables until
# find_package(Zephyr) below has run Kconfig -- by which point EXTRA_CONF_FILE is
# already consumed. See the header of app_net_type.cmake.
#
# The "eth" fallback must match the 'choice APP_NET_TYPE' default in Kconfig.
include($ENV{WORKSPACE_BASE}/common/scripts/cmake/app_net_type.cmake)
app_net_type_resolve(APP_NET_TYPE eth)

if (APP_NET_TYPE STREQUAL "wifi")
    list(APPEND EXTRA_CONF_FILE ${CMAKE_CURRENT_SOURCE_DIR}/conf/wifi.conf)
elseif (APP_NET_TYPE STREQUAL "serial")
    list(APPEND EXTRA_CONF_FILE ${CMAKE_CURRENT_SOURCE_DIR}/conf/serial_net.conf)
elseif (APP_NET_TYPE STREQUAL "eth")
    list(APPEND EXTRA_CONF_FILE ${CMAKE_CURRENT_SOURCE_DIR}/conf/wired_eth_net.conf)
elseif (APP_NET_TYPE STREQUAL "usb")
    list(APPEND EXTRA_CONF_FILE ${CMAKE_CURRENT_SOURCE_DIR}/conf/usb_net.conf)
endif()

# Applied LAST so the addressing decision cannot be overridden by a transport
# fragment. CONFIG_NET_DHCPV4 and the APP_IPV4_* symbols live only in this file.
list(APPEND EXTRA_CONF_FILE ${CMAKE_CURRENT_SOURCE_DIR}/conf/ip.conf)

find_package(Zephyr REQUIRED HINTS $ENV{ZEPHYR_BASE})

# Kconfig has now run. Fail loudly if it disagrees with the fragment we applied.
app_net_type_verify(${APP_NET_TYPE})

project(led_demo)

set(target app)

# Include the cmake script which builds protobuf bindings.
include($ENV{WORKSPACE_BASE}/common/scripts/cmake/build_proto.cmake)

# The following creates the target ${target}_proto.
nanopb_build_sources(${target} $ENV{WORKSPACE_BASE}/proto)

target_sources(
    ${target}
    PRIVATE
    src/main.c
    src/led.c
    src/rpc.c
    src/TcpServer.c
    )

# Exactly one net_*.c provides app_net_init(). net_l4.c carries the bring-up
# sequence shared by the three transports that use Zephyr's connection manager.
target_sources_ifdef(
    CONFIG_APP_NET_TYPE_WIFI
    ${target}
    PRIVATE
    src/net_wifi.c
    )

target_sources_ifdef(
    CONFIG_APP_NET_TYPE_SERIAL
    ${target}
    PRIVATE
    src/net_wired.c
    src/net_l4.c
    )

target_sources_ifdef(
    CONFIG_APP_NET_TYPE_ETH
    ${target}
    PRIVATE
    src/net_wired.c
    src/net_l4.c
    )

target_sources_ifdef(
    CONFIG_APP_NET_TYPE_USB
    ${target}
    PRIVATE
    src/net_usb.c
    src/net_l4.c
    )

target_sources_ifdef(
    CONFIG_APP_USE_STATIC_IP
    ${target}
    PRIVATE
    src/net_ip.c
    )

target_compile_options(
    ${target}
    PUBLIC
    -fmax-errors=5
    )

target_link_libraries(
    ${target}
    INTERFACE
    ${target}_proto
    )
```

## Kconfig
```
mainmenu "LED + eth RPC demo"

menu "App Options"

	choice APP_NET_TYPE
		prompt "Network type"
		default APP_NET_TYPE_ETH

		config APP_NET_TYPE_WIFI
		bool "wifi network"

		config APP_NET_TYPE_SERIAL
		bool "serial net"

		config APP_NET_TYPE_ETH
		bool "wired ethernet networking"

		config APP_NET_TYPE_USB
		bool "usb (CDC-ECM) networking"
	endchoice

	config APP_USE_STATIC_IP
	    bool "Use a static IP address rather than DHCP."

	config APP_IPV4_ADDR
	    string "Static IPv4 address."
	    default "192.168.1.15"

	config APP_IPV4_MASK
	    string "Static IPv4 netmask."
	    default "255.255.255.0"

	config APP_IPV4_GW
	    string "Static IPv4 gateway."
	    default "192.168.1.1"

endmenu

source "Kconfig.zephyr"

module = APP
module-str = "app"
source "subsys/logging/Kconfig.template.log_config"
```

## prj.conf
```kconfig
CONFIG_MAIN_STACK_SIZE=2048

CONFIG_APP_LOG_LEVEL_INF=y
CONFIG_LOG_BUFFER_SIZE=1024

CONFIG_SHELL=y
CONFIG_SHELL_BACKEND_SERIAL_LOG_MESSAGE_QUEUE_SIZE=1024
```

## boards/esp32s3_matrix_procpu.conf
```kconfig
# Network transport for this board. This single declaration drives both
# the Kconfig symbol and which conf/ fragment the build applies (see
# CMakeLists.txt and common/scripts/cmake/app_net_type.cmake).
# NOTE: this board normally uses 'wifi' networking; the app was
#       generated for 'eth'. Change this line to switch it.
CONFIG_APP_NET_TYPE_ETH=y
```

## boards/esp32s3_matrix_procpu.overlay
```dts
/*
 * Devicetree overlay for esp32s3_matrix_procpu.
 */

/* Onboard LED. Pin taken from applications/blinky. */
/ {
	leds {
		compatible = "gpio-leds";
		myled0: led_0 {
			gpios = <&gpio0 1 GPIO_ACTIVE_HIGH>;
			label = "Onboard LED 0";
		};
	};

	aliases {
		led0 = &myled0;
	};
};
```

## boards/w55rp20_evb_pico.overlay
```dts
/*
 * Devicetree overlay for w55rp20_evb_pico.
 */

/* This board defines the led0 alias in its own devicetree, so
 * the application does not need to. */
```

## src/main.c
```c
/** @brief LED + eth RPC demo
 *
 *  Generated by app_gen. Subsystem setup lives in src/app.h; see the README.
 */
#include <zephyr/kernel.h>
#include <zephyr/logging/log.h>

#include "app.h"

/** @brief Initialize the logging module. */
LOG_MODULE_REGISTER(app, CONFIG_APP_LOG_LEVEL);

int
main(void)
{
    int ret;

    LOG_INF("led_demo starting.");
    LOG_INF("MY LOCAL EDIT - must survive the update");

    /* Not fatal: a board without an led0 alias logs a warning and continues. */
    (void)app_led_init();

    ret = app_net_init();
    if (ret < 0)
    {
        LOG_ERR("Network init failed: %d", ret);
        return 0;
    }

    ret = app_rpc_init();
    if (ret < 0)
    {
        LOG_ERR("RPC init failed: %d", ret);
        return 0;
    }

    ret = app_TcpServer_init();
    if (ret < 0)
    {
        LOG_ERR("TcpServer init failed: %d", ret);
        return 0;
    }

    app_trace_init();

    while (1)
    {
        k_msleep(5000);
    }

    return 0;
}
```

## src/app.h
```c
/*******************************************************************************
 *  @file: app.h
 *
 *  @brief: Application-level init contract.
 *
 *  Each optional subsystem provides one app_*_init(). When a subsystem is not
 *  built, a no-op inline stands in, so main.c carries no preprocessor logic and
 *  reads identically in every generated app.
 *
 *  Networking is resolved at BUILD time, not generation time: the transport is
 *  declared per board in boards/<board>.conf and resolved by
 *  app_net_type_resolve(), so one app can be wifi on one board and eth on
 *  another. That is why app_net_init() stays behind CONFIG_APP_NET_TYPE_*
 *  rather than being generated in or out.
*******************************************************************************/
#ifndef APP_H
#define APP_H

/** @brief Brings the network up and blocks until it is usable.
    Provided by exactly one of src/net_*.c -- see CMakeLists.txt. */
#if defined(CONFIG_APP_NET_TYPE_WIFI) || defined(CONFIG_APP_NET_TYPE_SERIAL) \
    || defined(CONFIG_APP_NET_TYPE_ETH) || defined(CONFIG_APP_NET_TYPE_USB)
int app_net_init(void);
#else
static inline int app_net_init(void) { return 0; }
#endif

#if defined(CONFIG_TCPRPCSERVER)
int app_rpc_init(void);
#else
static inline int app_rpc_init(void) { return 0; }
#endif

#if defined(CONFIG_TRACERAM)
int app_trace_init(void);
#else
static inline int app_trace_init(void) { return 0; }
#endif

/** @brief Configures the onboard LED. Safe to call on a board with no led0
    alias -- see led.h. */
int app_led_init(void);
int app_TcpServer_init(void);

#endif /* APP_H */
```
